/*ATL 68K*/
/ {
	fragment {
			target-path = "/";
			__overlay__ {

			bat1: battery1 {
				compatible = "simple-battery";
				brand = "atl-4V45-5000mAh";
				charge-full-design-microamp-hours = <4872000>;
				charge-term-current-microamp = <256000>;
				constant_charge_voltage_max_microvolt = <4432000>;
				factory-internal-resistance-micro-ohms = <139000>;
				voltage-min-design-microvolt = <3455000>;
				ocv-capacity-celsius = <20>;
				ocv-capacity-table-0 = <4374000 100>, <4325000 95>, <4270000 90>,
							<4214000 85>, <4159000 80>, <4106000 75>,
							<4056000 70>, <4010000 65>, <3957000 60>,
							<3903000 55>, <3871000 50>, <3845000 45>,
							<3823000 40>, <3805000 35>, <3788000 30>,
							<3764000 25>, <3743000 20>, <3718000 15>,
							<3691000 10>, <3677000 5>, <3400000 0>;
				voltage-temp-table = <1404000 650>, <1307000 700>, <1203000 750>,
							<1095000 800>, <986000 850>, <878000 900>,
							<775000 950>, <678000 1000>, <590000 1050>,
							<510000 1100>, <440000 1150>, <378000 1200>,
							<324000 1250>, <278000 1300>, <238000 1350>,
							<204000 1400>, <175000 1450>, <150000 1500>,
							<129000 1550>, <111000 1600>, <96000 1650>,
							<83000 1700>, <73000 1750>, <63000 1800>,
							<55000 1850>, <48000 1900>, <42000 1950>;
				capacity-temp-table = <45 100>, <25 100>, <10 98>, <0 92>, <(-10) 86>, <(-20) 65>;
				resistance-temp-table = <45 100>, <25 100>, <10 324>, <0 854>, <(-10) 901>, <(-20) 1022>;
				charge-sdp-current-microamp = <480000 500000>;
				charge-dcp-current-microamp = <2200000 2200000>;
				charge-cdp-current-microamp = <1500000 1500000>;
				charge-unknown-current-microamp = <1200000 1200000>;
				charge-fchg-current-microamp = <1700000 1000000>; /*1700 1000*/
				cm-dcp-jeita-temp-table = <980 981 0 3980000 0 3980000>,
					<1000 1010 364000 3980000 364000 3980000>,
					<1050 1080 2200000 4432000 1425000 4180000>,
					<1120 1150 2200000 4432000 2200000 4432000>,
					<1160 1190 2200000 4432000 2200000 4432000>,
					<1450 1420 2200000 4432000 2200000 4432000>,
					<1530 1500 1425000 4112000 1425000 4112000>;
				cm-sdp-jeita-temp-table = <980 981 0 3980000 0 3980000>,
					<1000 1030 364000 3980000 364000 3980000>,
					<1050 1080 480000 4432000 480000 4432000>,
					<1120 1150 480000 4432000 480000 4432000>,
					<1160 1190 480000 4432000 480000 4432000>,
					<1450 1420 480000 4432000 480000 4432000>,
					<1530 1500 480000 4112000 480000 4112000>;
				cm-cdp-jeita-temp-table = <980 981 0 3980000 0 3980000>,
					<1000 1030 364000 3980000 364000 3980000>,
					<1050 1080 480000 4432000 480000 4432000>,
					<1120 1150 1000000 4432000 1000000 4432000>,
					<1160 1190 1500000 4432000 1500000 4432000>,
					<1450 1420 1500000 4432000 1500000 4432000>,
					<1530 1500 1000000 4112000 1000000 4112000>;
				cm-unknown-jeita-temp-table = <980 981 0 3980000 0 3980000>,
					<1000 1030 364000 3980000 364000 3980000>,
					<1050 1080 480000 4432000 480000 4432000>,
					<1120 1150 1000000 4432000 1000000 4432000>,
					<1160 1190 1200000 4432000 1200000 4432000>,
					<1450 1420 1200000 4432000 1200000 4432000>,
					<1530 1500 1000000 4112000 1000000 4112000>;
				cm-fchg-jeita-temp-table = <980 981 0 3980000 0 3980000>,/* <-2 invalid */
					<1000 1010 364000 3980000 364000 3980000>,/* -2-0 invalid */
					<1050 1060 1187000 4432000 712000 4180000>,/* 0-5 */
					<1120 1130 1187000 4432000 1187000 4432000>,/* 5-12 */
					<1160 1190 1662000 4432000 1187000 4180000>,/* 12-16 */
					<1220 1230 1500000 4432000 1500000 4432000>,/* 16-22 */
					<1340 1330 1700000 4432000 1590000 4180000>,/* 22-34 */
					<1370 1360 1590000 4432000 1590000 4432000>,/* 34-37 */
					<1400 1390 1400000 4432000 1400000 4432000>,/* 37-40 */
					<1420 1410 1330000 4432000 1330000 4432000>,/* 40-42 */
					<1450 1420 480000 4432000 480000 4432000>,/* 42-45 invalid */
					<1530 1500 480000 4112000 480000 4112000>;/* 45-53 invalid */
			};
		};
	};
};
