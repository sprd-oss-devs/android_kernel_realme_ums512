## drivers/input/touchscreen/focaltech_touch/Kconfig
```kconfig
#
# Focaltech Touchscreen driver configuration
#

config TOUCHSCREEN_FTS
	bool "Focaltech Touchscreen"
	depends on I2C
	help
	  Say y here if you have focal TDDI touch panel.

	  If unsure, say N.

	  To compile this driver as a module, choose M here: the
	  module will be called focal-tddi.
      
config TOUCHSCREEN_FTS_DIRECTORY
    string "Focaltech ts directory name"
    default "focaltech_touch"
    depends on TOUCHSCREEN_FTS
    
```

## drivers/input/touchscreen/ili9882n/Kconfig
```kconfig
#
# ili9881 driver
#

config TOUCHSCREEN_ILI9882N
	bool "ili9882n Touchscreen Driver"
        depends on I2C
        help
          Say y here if you have ili9882n TDDI touch panel.

          If unsure, say N.

          To compile this driver as a module, choose M here: the
          module will be called ili9882n-tddi.
```

## drivers/soc/oplus/oplus_devinfo/Kconfig
```kconfig
config OPLUS_DEVICE_IFNO
  tristate "config oplus devinfo software"
  select OPLUS_ARCH_FILE
  help
    define this config to compile devinfo.c for device register
```
